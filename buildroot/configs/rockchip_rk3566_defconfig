## buildroot/configs/rockchip_rk3566_defconfig
```kconfig
#include "qt.config"
#include "qt_app.config"
#include "audio.config"
#include "audio_gst.config"
#include "base.config"
#include "base_extra.config"
#include "benchmark.config"
#include "bt.config"
#include "camera.config"
#include "camera_gst.config"
#include "debug.config"
#include "debug2.config"
#include "weston.config"
#include "gpu.config"
#include "network.config"
#include "ntfs.config"
#include "video_mpp.config"
#include "video_gst.config"
#include "video_gst_rtsp.config"
#include "powermanager.config"
#include "rk356x_arm64.config"
#include "test.config"
#include "wifi.config"
#include "qt.config"
#include "qt_app.config"
BR2_PACKAGE_RKNPU2=y
BR2_PACKAGE_RKWIFIBT_AP6256=y
BR2_PACKAGE_RKWIFIBT_BTUART="ttyS1"
BR2_PACKAGE_TESTAPP=y
BR2_PACKAGE_QT5SERIALPORT=y

BR2_PACKAGE_RECOVERY=y
BR2_PACKAGE_RECOVERY_USE_UPDATEENGINE=y
BR2_PACKAGE_RECOVERY_UPDATEENGINEBIN=y
#BR2_PACKAGE_MINICOM=y
BR2_PACKAGE_IPROUTE2=y
BR2_PACKAGE_PPPD=y
```

## buildroot/configs/rockchip_rk356x_recovery_defconfig
```kconfig
#include "base.config"
#include "base_extra.config"
#include "recovery.config"
#include "rk356x_arm64.config"
#BR2_ROOTFS_OVERLAY="board/rockchip/rk356x/fs-overlay-recovery/"
BR2_PACKAGE_RECOVERY_USE_UPDATEENGINE=y
BR2_PACKAGE_RECOVERY_RECOVERYBIN=y
BR2_PACKAGE_RECOVERY_UPDATEENGINEBIN=y
```

## buildroot/package/testApp/Config.in
```kconfig
config BR2_PACKAGE_TESTAPP
    bool "testApp"
    help
        this is a app for rpdzkj function test
```

## kernel/drivers/rongpin/Kconfig
```kconfig
menu "rongpin support"

config RP_POWER
	tristate "rongpin rongpin 5v_en support"
	default y
	help
		rp_power_ctrl

config RP_GPIO
	default y
	tristate "rongpin rp gpio_ctl support"

config RP_STM706
        tristate "rongpin rp stm706 support"
        default y

endmenu
```
