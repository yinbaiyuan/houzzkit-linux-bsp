

&can2 {
		compatible = "rockchip,can-1.0";
    assigned-clocks = <&cru CLK_CAN2>;
    assigned-clock-rates = <150000000>;
    pinctrl-names = "default";
    pinctrl-0 = <&can2m0_pins>;
    status = "okay";
};

